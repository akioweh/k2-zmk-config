## hardware/drivers/iqs5xx/Kconfig
```kconfig
config ZMK_TRACKPAD_IQS5XX
    bool "IQS5xx-B000 contact producer"
    default y
    depends on ZMK_TRACKPAD && DT_HAS_AZOTEQ_IQS5XX_PTP_ENABLED && I2C && !ZMK_PTP_TEST_SOURCE
    help
      Native contacts only. No firmware mouse gestures or input listener.
      Factory electrode mapping/tuning is preserved.

config ZMK_IQS5XX_WORKQUEUE_STACK_SIZE
    int "IQS5xx sampling workqueue stack size"
    depends on ZMK_TRACKPAD_IQS5XX
    range 1024 8192
    default 1536
```

## hardware/dts/bindings/input/azoteq,iqs5xx-ptp.yaml
```yaml
# Copyright (c) 2026 The ZMK Contributors
# SPDX-License-Identifier: MIT
description: IQS5xx-B000 native multitouch contact producer (TPS43/TPS65)
compatible: "azoteq,iqs5xx-ptp"
include: i2c-device.yaml
properties:
  rdy-gpios:
    type: phandle-array
    required: true
  rst-gpios:
    type: phandle-array
    required: true
  x-resolution:
    type: int
    default: 2048
  y-resolution:
    type: int
    default: 1792
  invert-x:
    type: boolean
    description: Reverse the sensor X axis before the optional axis swap.
  invert-y:
    type: boolean
    description: Reverse the sensor Y axis before the optional axis swap.
  switch-xy:
    type: boolean
  filter-settings:
    type: int
    default: 0x0B
```

## west.yml
```yaml
manifest:
  projects:
    - name: zmk
      url: https://github.com/akioweh/zmk
      revision: b2e08265f146bbd00ef5f065b49dfa89e9d6eee8
      import: app/west.yml
    - name: zmk-rgbled-widget
      url: https://github.com/caksoylar/zmk-rgbled-widget
      revision: e6b467792a1dabef8cfa5c9fd26bfefc9c16662b
      path: modules/toucan/zmk-rgbled-widget
  self:
    path: manifest
```
